## CMakeLists.txt
```
cmake_minimum_required(VERSION 3.20.0)

find_package(Zephyr REQUIRED HINTS $ENV{ZEPHYR_BASE})
project(emopet_tag)

target_sources(app PRIVATE
  src/main.c
)
```

## west.yml
```
manifest:
  version: "1.2"

  remotes:
    - name: ncs
      url-base: https://github.com/nrfconnect

  projects:
    - name: nrf
      remote: ncs
      revision: v3.4.1
      import: true

  self:
    path: emopet
```

## prj.conf
```kconfig
# EMOPET TAG compile-harness configuration.
# nRF52840 DK is NOT production MS88SF3 board authority.

CONFIG_BT=y
CONFIG_BT_PERIPHERAL=y
CONFIG_BT_MAX_CONN=1
CONFIG_BT_DEVICE_NAME="EMOPET TAG"
CONFIG_BT_DEVICE_APPEARANCE=0

CONFIG_ENTROPY_GENERATOR=y
CONFIG_NEWLIB_LIBC=y
CONFIG_FPU=y

CONFIG_LOG=y
CONFIG_LOG_DEFAULT_LEVEL=3
CONFIG_MAIN_STACK_SIZE=2048
```

## src/main.c
```c
/*
 * EMOPET TAG nRF Connect SDK / Zephyr peripheral scaffold.
 *
 * Platform authority: config/firmware/tag-platform-authority-v1.json
 * Compile harness: nRF52840 DK only.
 * Production MS88SF3 board authority remains OPEN under #625.
 */

#include "emopet_gatt.h"

#include <zephyr/kernel.h>
#include <zephyr/logging/log.h>

#include "activity_variability.h"

LOG_MODULE_REGISTER(emopet_tag, LOG_LEVEL_INF);

int main(void)
{
    int err;

    activity_variability_init();

    err = emopet_gatt_init();
    if (err != 0) {
        LOG_ERR("Bluetooth init failed: %d", err);
        return err;
    }

    err = emopet_gatt_start_advertising();
    if (err != 0) {
        LOG_ERR("Advertising start failed: %d", err);
        return err;
    }

    LOG_INF("EMOPET TAG BLE peripheral scaffold ready");

    /*
     * No synthetic feature emission here.
     *
     * A future real IMU feature task may call
     * emopet_gatt_publish_activity_variability() only after it owns a real
     * activity_variability_snapshot_t and quality state.
     */
    while (true) {
        k_sleep(K_SECONDS(60));
    }

    return 0;
}
```

## src/emopet_gatt.h
```c
/*
 * EMOPET TAG GATT peripheral scaffold.
 *
 * Device Trust remains #66. GATT connection and CRC-valid payloads are not
 * physical-device authentication.
 */

#pragma once

#include <stdint.h>

#include "activity_feature_summary.h"

#ifdef __cplusplus
extern "C" {
#endif

int emopet_gatt_init(void);
int emopet_gatt_start_advertising(void);

/**
 * Build the canonical 27-byte activity feature frame from the firmware
 * serializer and notify subscribed central(s).
 *
 * Boot-session/sequence/window-end are device-local transport provenance only,
 * never security identity or UTC authority.
 */
int emopet_gatt_publish_activity_variability(
    activity_variability_snapshot_t snapshot,
    tag_feature_quality_t quality
);

#ifdef __cplusplus
}
#endif
```
