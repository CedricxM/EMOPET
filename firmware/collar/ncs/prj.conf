## CMakeLists.txt
```
cmake_minimum_required(VERSION 3.20.0)

find_package(Zephyr REQUIRED HINTS $ENV{ZEPHYR_BASE})
project(emopet_tag)

set(EMOPET_COLLAR_MAIN ${CMAKE_CURRENT_SOURCE_DIR}/../main)

target_sources(app PRIVATE
  src/main.c
  src/emopet_gatt.c
  src/device_pop_signer_psa.c
  ${EMOPET_COLLAR_MAIN}/security/device_pop_preimage.c
  ${EMOPET_COLLAR_MAIN}/transport/activity_feature_summary.c
  ${EMOPET_COLLAR_MAIN}/transport/clock_anchor_transport.c
  ${EMOPET_COLLAR_MAIN}/sensors/activity_variability.c
)

target_include_directories(app PRIVATE
  src
  ${EMOPET_COLLAR_MAIN}/security
  ${EMOPET_COLLAR_MAIN}/transport
  ${EMOPET_COLLAR_MAIN}/sensors
)


if(CONFIG_EMOPET_DEVICE_KEY_PROVISIONING)
  target_sources(app PRIVATE
    src/device_identity_key_provisioner_psa.c
  )
endif()
```

## Kconfig
```
mainmenu "EMOPET TAG"

source "Kconfig.zephyr"

menu "EMOPET Device Trust"

config EMOPET_DEVICE_KEY_PROVISIONING
    bool "Enable bounded P-256 identity-key provisioning primitive"
    default n
    depends on PSA_CRYPTO
    depends on SECURE_STORAGE
    depends on HW_UNIQUE_KEY
    depends on SECURE_STORAGE_ITS_TRANSFORM_AEAD_KEY_PROVIDER_HUK_LIBRARY
    help
      Enables the source primitive that creates one persistent P-256 identity
      key under an explicit PSA key id and exports the public key only.

      This option is deliberately OFF by default. It must not be enabled for
      EMOPET production until #657 records NSIB/HUK provisioning, Secure Storage
      protection, partition/layout evidence, APPROTECT policy and representative
      MS88SF3 reboot/sign/verify evidence.

endmenu
```

## west.yml
```
manifest:
  version: "1.2"

  remotes:
    - name: ncs
      url-base: https://github.com/nrfconnect

  projects:
    - name: nrf
      remote: ncs
      revision: v3.4.0
      import: true

  self:
    path: emopet
```

## prj.conf
```kconfig
CONFIG_BT=y
CONFIG_BT_PERIPHERAL=y
CONFIG_BT_MAX_CONN=1
CONFIG_BT_DEVICE_NAME="EMOPET TAG"
CONFIG_BT_DEVICE_APPEARANCE=0

CONFIG_ENTROPY_GENERATOR=y
CONFIG_NEWLIB_LIBC=y
CONFIG_FPU=y

CONFIG_LOG=y
CONFIG_LOG_DEFAULT_LEVEL=3
CONFIG_MAIN_STACK_SIZE=2048

# DEVICE-TRUST-ID-09 source candidate: PSA ECDSA P-256 signing only.
# Key generation/storage/provisioning remains a separate authority.
CONFIG_PSA_CRYPTO=y
CONFIG_PSA_WANT_ALG_SHA_256=y
CONFIG_PSA_WANT_ALG_ECDSA=y
CONFIG_PSA_WANT_ECC_SECP_R1_256=y


# DEVICE-TRUST-ID-10 remains source-only until #657 target evidence exists.
# Intentionally NOT enabled here:
# CONFIG_EMOPET_DEVICE_KEY_PROVISIONING
# CONFIG_SECURE_STORAGE
# CONFIG_HW_UNIQUE_KEY
# CONFIG_SECURE_STORAGE_ITS_TRANSFORM_AEAD_KEY_PROVIDER_HUK_LIBRARY
```

## src/main.c
```c
/*
 * EMOPET TAG nRF Connect SDK / Zephyr peripheral scaffold.
 *
 * Compile harness: nRF52840 DK only.
 * Production MS88SF3 board authority remains OPEN under #625.
 */

#include "emopet_gatt.h"

#include <zephyr/kernel.h>
#include <zephyr/logging/log.h>

#include "activity_variability.h"

LOG_MODULE_REGISTER(emopet_tag, LOG_LEVEL_INF);

int main(void)
{
    int err;

    activity_variability_init();

    err = emopet_gatt_init();
    if (err != 0) {
        LOG_ERR("Bluetooth init failed: %d", err);
        return err;
    }

    err = emopet_gatt_start_advertising();
    if (err != 0) {
        LOG_ERR("Advertising start failed: %d", err);
        return err;
    }

    LOG_INF("EMOPET TAG BLE peripheral scaffold ready");

    /*
     * No synthetic feature emission here.
     *
     * A future real IMU feature task may call
     * emopet_gatt_publish_activity_variability() only after it owns a real
     * activity_variability_snapshot_t and quality state.
     */
    while (true) {
        k_sleep(K_SECONDS(60));
    }

    return 0;
}
```

## src/device_identity_key_provisioner_psa.c
```c
/*
 * device_identity_key_provisioner_psa.c — source-only provisioning primitive.
 */

#include "device_identity_key_provisioner_psa.h"
#include "device_identity_key_slots.h"

static void secure_zero(void *buffer, size_t length)
{
    volatile uint8_t *p = (volatile uint8_t *)buffer;
    while (length-- > 0u) {
        *p++ = 0u;
    }
}

static device_identity_key_provision_result_t
rollback_generated_key(psa_key_id_t key_id)
{
    return psa_destroy_key(key_id) == PSA_SUCCESS
        ? DEVICE_IDENTITY_KEY_PROVISION_PUBLIC_EXPORT_ERROR
        : DEVICE_IDENTITY_KEY_PROVISION_ROLLBACK_ERROR;
}

device_identity_key_provision_result_t
device_identity_key_provision_p256_v1(
    psa_key_id_t key_id,
    uint32_t credential_version,
    device_identity_key_provision_receipt_t *receipt
)
{
    if (
        key_id == PSA_KEY_ID_NULL
        || credential_version == 0u
        || receipt == NULL
    ) {
        return DEVICE_IDENTITY_KEY_PROVISION_INVALID_ARGUMENT;
    }

    secure_zero(receipt, sizeof(*receipt));

    if (!device_identity_key_id_is_reserved_slot(key_id)) {
        return DEVICE_IDENTITY_KEY_PROVISION_KEY_ID_NOT_RESERVED;
    }

    psa_key_attributes_t existing = PSA_KEY_ATTRIBUTES_INIT;
    const psa_status_t lookup_status =
        psa_get_key_attributes(key_id, &existing);

    if (lookup_status == PSA_SUCCESS) {
        psa_reset_key_attributes(&existing);
        return DEVICE_IDENTITY_KEY_PROVISION_ALREADY_EXISTS;
    }
    psa_reset_key_attributes(&existing);

    if (lookup_status != PSA_ERROR_DOES_NOT_EXIST) {
        return DEVICE_IDENTITY_KEY_PROVISION_LOOKUP_ERROR;
    }

    psa_key_attributes_t attrs = PSA_KEY_ATTRIBUTES_INIT;
    psa_set_key_type(
        &attrs,
        PSA_KEY_TYPE_ECC_KEY_PAIR(PSA_ECC_FAMILY_SECP_R1)
    );
    psa_set_key_bits(&attrs, 256u);
    psa_set_key_usage_flags(&attrs, PSA_KEY_USAGE_SIGN_HASH);
    psa_set_key_algorithm(
        &attrs,
        PSA_ALG_ECDSA(PSA_ALG_SHA_256)
    );
    psa_set_key_lifetime(&attrs, PSA_KEY_LIFETIME_PERSISTENT);
    psa_set_key_id(&attrs, key_id);

    psa_key_id_t generated_id = PSA_KEY_ID_NULL;
    const psa_status_t generate_status =
        psa_generate_key(&attrs, &generated_id);

    psa_reset_key_attributes(&attrs);

    if (generate_status != PSA_SUCCESS) {
        return DEVICE_IDENTITY_KEY_PROVISION_GENERATE_ERROR;
    }

    if (generated_id != key_id) {
        if (
            generated_id != PSA_KEY_ID_NULL
            && psa_destroy_key(generated_id) != PSA_SUCCESS
        ) {
            return DEVICE_IDENTITY_KEY_PROVISION_ROLLBACK_ERROR;
        }
        return DEVICE_IDENTITY_KEY_PROVISION_KEY_ID_MISMATCH;
    }

    size_t public_key_length = 0u;
    const psa_status_t export_status = psa_export_public_key(
        key_id,
        receipt->public_key_sec1,
        sizeof(receipt->public_key_sec1),
        &public_key_length
    );

    if (export_status != PSA_SUCCESS) {
        secure_zero(receipt, sizeof(*receipt));
        return rollback_generated_key(key_id);
    }

    if (
        public_key_length != DEVICE_IDENTITY_P256_PUBLIC_KEY_SIZE
        || receipt->public_key_sec1[0] != 0x04u
    ) {
        secure_zero(receipt, sizeof(*receipt));
        const device_identity_key_provision_result_t rollback =
            rollback_generated_key(key_id);
        return rollback == DEVICE_IDENTITY_KEY_PROVISION_ROLLBACK_ERROR
            ? rollback
            : DEVICE_IDENTITY_KEY_PROVISION_PUBLIC_KEY_FORMAT_ERROR;
    }

    receipt->key_id = key_id;
    receipt->credential_version = credential_version;
    return DEVICE_IDENTITY_KEY_PROVISION_OK;
}
```

## src/device_identity_key_provisioner_psa.h
```c
/*
 * device_identity_key_provisioner_psa.h — bounded on-device identity-key
 * provisioning primitive for #657.
 *
 * This source owns creation of a new persistent PSA P-256 key only when the
 * application explicitly enables CONFIG_EMOPET_DEVICE_KEY_PROVISIONING.
 *
 * It does NOT own:
 * - HUK/KDR provisioning;
 * - NSIB configuration;
 * - Secure Storage target proof;
 * - credential activation;
 * - backend enrollment;
 * - rotation/revocation/RMA orchestration;
 * - Device Data Trust success.
 */

#pragma once

#include <stddef.h>
#include <stdint.h>

#include <psa/crypto.h>

#ifdef __cplusplus
extern "C" {
#endif

#define DEVICE_IDENTITY_P256_PUBLIC_KEY_SIZE 65u

typedef enum {
    DEVICE_IDENTITY_KEY_PROVISION_OK = 0,
    DEVICE_IDENTITY_KEY_PROVISION_INVALID_ARGUMENT = 1,
    DEVICE_IDENTITY_KEY_PROVISION_KEY_ID_NOT_RESERVED = 2,
    DEVICE_IDENTITY_KEY_PROVISION_ALREADY_EXISTS = 3,
    DEVICE_IDENTITY_KEY_PROVISION_LOOKUP_ERROR = 4,
    DEVICE_IDENTITY_KEY_PROVISION_GENERATE_ERROR = 5,
    DEVICE_IDENTITY_KEY_PROVISION_KEY_ID_MISMATCH = 6,
    DEVICE_IDENTITY_KEY_PROVISION_PUBLIC_EXPORT_ERROR = 7,
    DEVICE_IDENTITY_KEY_PROVISION_PUBLIC_KEY_FORMAT_ERROR = 8,
    DEVICE_IDENTITY_KEY_PROVISION_ROLLBACK_ERROR = 9,
} device_identity_key_provision_result_t;

typedef struct {
    psa_key_id_t key_id;
    uint32_t credential_version;
    uint8_t public_key_sec1[DEVICE_IDENTITY_P256_PUBLIC_KEY_SIZE];
} device_identity_key_provision_receipt_t;

/**
 * Create a new persistent ECDSA P-256 signing key under an explicit PSA key id.
 *
 * Preconditions:
 * - PSA Crypto has already been initialized;
 * - the selected target provides the approved Secure Storage + HUK/KDR path;
 * - key_id and credential_version are supplied by provisioning authority.
 *
 * Refuses any key id outside the reserved EMOPET identity slots A/B.
 * Refuses to overwrite an existing key id.
 * Exports only the SEC1 uncompressed public key.
 *
 * On a failure after key creation, the newly-created key is destroyed as
 * rollback. This is not a general runtime key-destruction API.
 */
device_identity_key_provision_result_t
device_identity_key_provision_p256_v1(
    psa_key_id_t key_id,
    uint32_t credential_version,
    device_identity_key_provision_receipt_t *receipt
);

#ifdef __cplusplus
}
#endif
```

## src/device_identity_key_slots.h
```c
/*
 * device_identity_key_slots.h — EMOPET PSA application key-id namespace.
 *
 * Key ids are storage addresses, not credential identities.
 * Credential versions must never be derived from slot parity or vice versa.
 */

#pragma once

#include <stdbool.h>

#include <psa/crypto.h>

#ifdef __cplusplus
extern "C" {
#endif

#define EMOPET_DEVICE_TRUST_KEY_BLOCK_MIN ((psa_key_id_t)0x00010000u)
#define EMOPET_DEVICE_TRUST_KEY_BLOCK_MAX ((psa_key_id_t)0x0001000fu)

#define EMOPET_DEVICE_IDENTITY_KEY_SLOT_A ((psa_key_id_t)0x00010000u)
#define EMOPET_DEVICE_IDENTITY_KEY_SLOT_B ((psa_key_id_t)0x00010001u)

typedef enum {
    DEVICE_IDENTITY_KEY_SLOT_INVALID = 0,
    DEVICE_IDENTITY_KEY_SLOT_A = 1,
    DEVICE_IDENTITY_KEY_SLOT_B = 2,
} device_identity_key_slot_t;

static inline bool device_identity_key_id_is_reserved_slot(psa_key_id_t key_id)
{
    return key_id == EMOPET_DEVICE_IDENTITY_KEY_SLOT_A
        || key_id == EMOPET_DEVICE_IDENTITY_KEY_SLOT_B;
}

static inline device_identity_key_slot_t
device_identity_key_slot_from_id(psa_key_id_t key_id)
{
    if (key_id == EMOPET_DEVICE_IDENTITY_KEY_SLOT_A) {
        return DEVICE_IDENTITY_KEY_SLOT_A;
    }
    if (key_id == EMOPET_DEVICE_IDENTITY_KEY_SLOT_B) {
        return DEVICE_IDENTITY_KEY_SLOT_B;
    }
    return DEVICE_IDENTITY_KEY_SLOT_INVALID;
}

#ifdef __cplusplus
}
#endif
```

## src/device_pop_signer_psa.c
```c
/*
 * device_pop_signer_psa.c — bounded opaque-key PSA signer.
 */

#include "device_pop_signer_psa.h"


static void secure_zero(void *buffer, size_t length)
{
    volatile uint8_t *p = (volatile uint8_t *)buffer;
    while (length-- > 0u) {
        *p++ = 0u;
    }
}

device_pop_sign_result_t device_pop_signer_psa_init(void)
{
    return psa_crypto_init() == PSA_SUCCESS
        ? DEVICE_POP_SIGN_OK
        : DEVICE_POP_SIGN_CRYPTO_INIT_ERROR;
}

static int key_policy_matches(psa_key_id_t key_id)
{
    psa_key_attributes_t attrs = PSA_KEY_ATTRIBUTES_INIT;
    psa_status_t status = psa_get_key_attributes(key_id, &attrs);
    if (status != PSA_SUCCESS) {
        return 0;
    }

    const psa_key_type_t type = psa_get_key_type(&attrs);
    const size_t bits = psa_get_key_bits(&attrs);
    const psa_key_usage_t usage = psa_get_key_usage_flags(&attrs);
    const psa_algorithm_t alg = psa_get_key_algorithm(&attrs);

    const int ok =
        PSA_KEY_TYPE_IS_ECC_KEY_PAIR(type)
        && PSA_KEY_TYPE_ECC_GET_FAMILY(type) == PSA_ECC_FAMILY_SECP_R1
        && bits == 256u
        && (usage & PSA_KEY_USAGE_SIGN_HASH) != 0u
        && alg == PSA_ALG_ECDSA(PSA_ALG_SHA_256);

    psa_reset_key_attributes(&attrs);
    return ok;
}

device_pop_sign_result_t device_pop_sign_challenge_v1(
    psa_key_id_t key_id,
    const device_pop_preimage_input_v1_t *input,
    uint8_t signature[DEVICE_POP_SIGNATURE_V1_SIZE]
)
{
    if (
        key_id == PSA_KEY_ID_NULL
        || input == NULL
        || signature == NULL
    ) {
        return DEVICE_POP_SIGN_INVALID_ARGUMENT;
    }

    if (!key_policy_matches(key_id)) {
        return DEVICE_POP_SIGN_KEY_POLICY_MISMATCH;
    }

    uint8_t preimage[DEVICE_POP_PREIMAGE_V1_SIZE];
    uint8_t digest[DEVICE_POP_SHA256_SIZE];
    size_t digest_len = 0u;
    size_t signature_len = 0u;

    const device_pop_preimage_result_t preimage_result =
        device_pop_build_preimage_v1(
            input,
            preimage,
            sizeof(preimage)
        );

    if (preimage_result != DEVICE_POP_PREIMAGE_OK) {
        secure_zero(preimage, sizeof(preimage));
        return DEVICE_POP_SIGN_PREIMAGE_ERROR;
    }

    const psa_status_t hash_status = psa_hash_compute(
        PSA_ALG_SHA_256,
        preimage,
        sizeof(preimage),
        digest,
        sizeof(digest),
        &digest_len
    );

    secure_zero(preimage, sizeof(preimage));

    if (
        hash_status != PSA_SUCCESS
        || digest_len != DEVICE_POP_SHA256_SIZE
    ) {
        secure_zero(digest, sizeof(digest));
        return DEVICE_POP_SIGN_HASH_ERROR;
    }

    const psa_status_t sign_status = psa_sign_hash(
        key_id,
        PSA_ALG_ECDSA(PSA_ALG_SHA_256),
        digest,
        digest_len,
        signature,
        DEVICE_POP_SIGNATURE_V1_SIZE,
        &signature_len
    );

    secure_zero(digest, sizeof(digest));

    if (sign_status != PSA_SUCCESS) {
        secure_zero(signature, DEVICE_POP_SIGNATURE_V1_SIZE);
        return DEVICE_POP_SIGN_SIGNATURE_ERROR;
    }

    if (signature_len != DEVICE_POP_SIGNATURE_V1_SIZE) {
        secure_zero(signature, DEVICE_POP_SIGNATURE_V1_SIZE);
        return DEVICE_POP_SIGN_SIGNATURE_SIZE_ERROR;
    }

    return DEVICE_POP_SIGN_OK;
}
```

## src/device_pop_signer_psa.h
```c
/*
 * device_pop_signer_psa.h — bounded PSA ECDSA P-256 signer primitive.
 *
 * This module signs only the canonical DEVICE_POP_CHALLENGE_V1 preimage.
 * It does NOT generate/import/export/destroy keys and does not own storage.
 */

#pragma once

#include <stddef.h>
#include <stdint.h>
#include <psa/crypto.h>

#include "device_pop_preimage.h"

#ifdef __cplusplus
extern "C" {
#endif

#define DEVICE_POP_SIGNATURE_V1_SIZE 64u
#define DEVICE_POP_SHA256_SIZE 32u

typedef enum {
    DEVICE_POP_SIGN_OK = 0,
    DEVICE_POP_SIGN_INVALID_ARGUMENT = 1,
    DEVICE_POP_SIGN_KEY_POLICY_MISMATCH = 2,
    DEVICE_POP_SIGN_PREIMAGE_ERROR = 3,
    DEVICE_POP_SIGN_HASH_ERROR = 4,
    DEVICE_POP_SIGN_SIGNATURE_ERROR = 5,
    DEVICE_POP_SIGN_SIGNATURE_SIZE_ERROR = 6,
    DEVICE_POP_SIGN_CRYPTO_INIT_ERROR = 7,
} device_pop_sign_result_t;

/**
 * Initialize the PSA Crypto subsystem before signing.
 *
 * This does not generate/open/import any device credential. Key lifecycle and
 * persistent storage remain a separate authority.
 */
device_pop_sign_result_t device_pop_signer_psa_init(void);

/**
 * Sign DEVICE_POP_CHALLENGE_V1 using an already-provisioned opaque PSA key id.
 *
 * Required key policy:
 * - ECC key pair;
 * - secp256r1 / P-256;
 * - 256 bits;
 * - SIGN_HASH usage;
 * - PSA_ALG_ECDSA(PSA_ALG_SHA_256).
 *
 * Output is PSA ECDSA raw R||S (32 bytes each).
 */
device_pop_sign_result_t device_pop_sign_challenge_v1(
    psa_key_id_t key_id,
    const device_pop_preimage_input_v1_t *input,
    uint8_t signature[DEVICE_POP_SIGNATURE_V1_SIZE]
);

#ifdef __cplusplus
}
#endif
```

## src/emopet_ble_ids.h
```c
/*
 * Controlled EMOPET proprietary 128-bit GATT UUIDs.
 *
 * Authority: config/ble/uuid-authority-v1.json
 * Do not replace with Bluetooth Base UUID aliases.
 */

#pragma once

#include <zephyr/bluetooth/uuid.h>

#define BT_UUID_EMOPET_SERVICE_VAL \
    BT_UUID_128_ENCODE(0xe4e2e9a3, 0x39c8, 0x4140, 0xaba9, 0xc4e37713f59a)

#define BT_UUID_EMOPET_SENSOR_FRAME_VAL \
    BT_UUID_128_ENCODE(0x66ae0c98, 0xa8ce, 0x4319, 0xb47d, 0xf09fa88d4d83)

#define BT_UUID_EMOPET_FEATURE_SUMMARY_VAL \
    BT_UUID_128_ENCODE(0x01141d55, 0xa776, 0x4091, 0xb068, 0x83f0804d8781)

#define BT_UUID_EMOPET_CONFIG_VAL \
    BT_UUID_128_ENCODE(0x8d5fa4ff, 0xd1fa, 0x49c3, 0x9ce4, 0x2e8865e4d478)
```

## src/emopet_gatt.c
```c
/*
 * EMOPET TAG GATT peripheral scaffold for nRF Connect SDK / Zephyr.
 *
 * This source establishes protocol wiring only. The MS88SF3 production board
 * definition, target flashing, physical-device authentication and real radio
 * evidence remain open under #625/#66.
 */

#include "emopet_gatt.h"
#include "emopet_ble_ids.h"
#include "clock_anchor_transport.h"

#include <errno.h>
#include <stdbool.h>
#include <stddef.h>
#include <stdint.h>

#include <zephyr/bluetooth/bluetooth.h>
#include <zephyr/bluetooth/gatt.h>
#include <zephyr/kernel.h>
#include <zephyr/random/random.h>
#include <zephyr/sys/util.h>

static struct bt_uuid_128 emopet_service_uuid =
    BT_UUID_INIT_128(BT_UUID_EMOPET_SERVICE_VAL);
static struct bt_uuid_128 emopet_sensor_frame_uuid =
    BT_UUID_INIT_128(BT_UUID_EMOPET_SENSOR_FRAME_VAL);
static struct bt_uuid_128 emopet_feature_summary_uuid =
    BT_UUID_INIT_128(BT_UUID_EMOPET_FEATURE_SUMMARY_VAL);
static struct bt_uuid_128 emopet_config_uuid =
    BT_UUID_INIT_128(BT_UUID_EMOPET_CONFIG_VAL);

static bool feature_notify_enabled;
static bool config_notify_enabled;
static uint32_t boot_session_id;
static uint16_t feature_sequence;

static void feature_ccc_changed(
    const struct bt_gatt_attr *attr,
    uint16_t value
)
{
    ARG_UNUSED(attr);
    feature_notify_enabled = (value == BT_GATT_CCC_NOTIFY);
}

static void config_ccc_changed(
    const struct bt_gatt_attr *attr,
    uint16_t value
)
{
    ARG_UNUSED(attr);
    config_notify_enabled = (value == BT_GATT_CCC_NOTIFY);
}

static ssize_t config_write(
    struct bt_conn *conn,
    const struct bt_gatt_attr *attr,
    const void *buf,
    uint16_t len,
    uint16_t offset,
    uint8_t flags
)
{
    ARG_UNUSED(conn);
    ARG_UNUSED(attr);
    ARG_UNUSED(flags);

    if (offset != 0u) {
        return BT_GATT_ERR(BT_ATT_ERR_INVALID_OFFSET);
    }
    if (len != TAG_CLOCK_ANCHOR_REQUEST_SIZE) {
        return BT_GATT_ERR(BT_ATT_ERR_INVALID_ATTRIBUTE_LEN);
    }
    if (!config_notify_enabled) {
        return BT_GATT_ERR(BT_ATT_ERR_WRITE_NOT_PERMITTED);
    }

    uint32_t request_nonce = 0u;
    const tag_clock_anchor_result_t parsed = tag_clock_anchor_parse_request(
        (const uint8_t *)buf,
        len,
        &request_nonce
    );
    if (parsed != TAG_CLOCK_ANCHOR_OK) {
        return BT_GATT_ERR(BT_ATT_ERR_VALUE_NOT_ALLOWED);
    }

    uint8_t response[TAG_CLOCK_ANCHOR_RESPONSE_SIZE];
    const uint32_t device_ms = k_uptime_get_32();
    const tag_clock_anchor_result_t encoded = tag_clock_anchor_encode_response(
        request_nonce,
        boot_session_id,
        device_ms,
        response,
        sizeof(response)
    );
    if (encoded != TAG_CLOCK_ANCHOR_OK) {
        return BT_GATT_ERR(BT_ATT_ERR_UNLIKELY);
    }

    const int notify_err = bt_gatt_notify_uuid(
        NULL,
        &emopet_config_uuid.uuid,
        &emopet_svc.attrs[0],
        response,
        sizeof(response)
    );
    if (notify_err != 0) {
        return BT_GATT_ERR(BT_ATT_ERR_UNLIKELY);
    }

    return (ssize_t)len;
}

/*
 * SensorFrame remains registered for protocol continuity, but this scaffold
 * deliberately does not invent a new TAG SensorFrame serializer.
 */
BT_GATT_SERVICE_DEFINE(
    emopet_svc,
    BT_GATT_PRIMARY_SERVICE(&emopet_service_uuid.uuid),

    BT_GATT_CHARACTERISTIC(
        &emopet_sensor_frame_uuid.uuid,
        BT_GATT_CHRC_NOTIFY,
        BT_GATT_PERM_NONE,
        NULL,
        NULL,
        NULL
    ),
    BT_GATT_CCC(NULL, BT_GATT_PERM_READ | BT_GATT_PERM_WRITE),

    BT_GATT_CHARACTERISTIC(
        &emopet_feature_summary_uuid.uuid,
        BT_GATT_CHRC_NOTIFY,
        BT_GATT_PERM_NONE,
        NULL,
        NULL,
        NULL
    ),
    BT_GATT_CCC(
        feature_ccc_changed,
        BT_GATT_PERM_READ | BT_GATT_PERM_WRITE
    ),

    BT_GATT_CHARACTERISTIC(
        &emopet_config_uuid.uuid,
        BT_GATT_CHRC_WRITE | BT_GATT_CHRC_NOTIFY,
        BT_GATT_PERM_WRITE,
        NULL,
        config_write,
        NULL
    ),
    BT_GATT_CCC(
        config_ccc_changed,
        BT_GATT_PERM_READ | BT_GATT_PERM_WRITE
    )
);

static const struct bt_data adv_data[] = {
    BT_DATA_BYTES(
        BT_DATA_FLAGS,
        BT_LE_AD_GENERAL | BT_LE_AD_NO_BREDR
    ),
    BT_DATA_BYTES(
        BT_DATA_UUID128_ALL,
        BT_UUID_EMOPET_SERVICE_VAL
    ),
};

static const struct bt_data scan_response[] = {
    BT_DATA(
        BT_DATA_NAME_COMPLETE,
        CONFIG_BT_DEVICE_NAME,
        sizeof(CONFIG_BT_DEVICE_NAME) - 1
    ),
};

int emopet_gatt_init(void)
{
    int err = bt_enable(NULL);
    if (err != 0) {
        return err;
    }

    /*
     * Replay/session discriminator only.
     * This is intentionally non-cryptographic and must never be used as
     * Device Trust, key material, nonce authority or proof of possession.
     */
    boot_session_id = sys_rand32_get();
    feature_sequence = 0;
    feature_notify_enabled = false;
    config_notify_enabled = false;

    return 0;
}

int emopet_gatt_start_advertising(void)
{
    return bt_le_adv_start(
        BT_LE_ADV_CONN_FAST_1,
        adv_data,
        ARRAY_SIZE(adv_data),
        scan_response,
        ARRAY_SIZE(scan_response)
    );
}

int emopet_gatt_publish_activity_variability(
    activity_variability_snapshot_t snapshot,
    tag_feature_quality_t quality,
    uint32_t window_end_ms
)
{
    uint8_t frame[TAG_FEATURE_SUMMARY_FRAME_SIZE];

    if (!feature_notify_enabled) {
        return -EAGAIN;
    }

    const tag_activity_feature_summary_input_t input = {
        .sequence = feature_sequence,
        .boot_session_id = boot_session_id,
        .window_end_ms = window_end_ms,
        .observation = snapshot,
        .quality = quality,
    };

    const tag_feature_summary_result_t encoded =
        tag_feature_summary_encode_activity_variability(
            &input,
            frame,
            sizeof(frame)
        );

    if (encoded != TAG_FEATURE_SUMMARY_OK) {
        return -EINVAL;
    }

    const int err = bt_gatt_notify_uuid(
        NULL,
        &emopet_feature_summary_uuid.uuid,
        &emopet_svc.attrs[0],
        frame,
        sizeof(frame)
    );

    if (err == 0) {
        feature_sequence++;
    }

    return err;
}
```

## src/emopet_gatt.h
```c
/*
 * EMOPET TAG GATT peripheral scaffold.
 *
 * Device Trust remains #66. GATT connection and CRC-valid payloads are not
 * physical-device authentication.
 */

#pragma once

#include <stdint.h>

#include "activity_feature_summary.h"

#ifdef __cplusplus
extern "C" {
#endif

int emopet_gatt_init(void);
int emopet_gatt_start_advertising(void);

/**
 * Build the canonical 27-byte activity feature frame from the firmware
 * serializer and notify subscribed central(s).
 *
 * `window_end_ms` is the monotonic end of the MEASUREMENT WINDOW supplied by
 * the producer. It must not be replaced with notification/send time.
 *
 * Boot-session/sequence remain device-local transport provenance only, never
 * security identity or UTC authority.
 */
int emopet_gatt_publish_activity_variability(
    activity_variability_snapshot_t snapshot,
    tag_feature_quality_t quality,
    uint32_t window_end_ms
);

#ifdef __cplusplus
}
#endif
```
