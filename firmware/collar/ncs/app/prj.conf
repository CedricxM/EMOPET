## CMakeLists.txt
```
cmake_minimum_required(VERSION 3.20.0)

find_package(Zephyr REQUIRED HINTS $ENV{ZEPHYR_BASE})
project(emopet_tag_p0)

target_sources(app PRIVATE
  src/main.c
  src/emopet_gatt.c
  ${CMAKE_CURRENT_SOURCE_DIR}/../../main/sensors/activity_variability.c
  ${CMAKE_CURRENT_SOURCE_DIR}/../../main/transport/activity_feature_summary.c
)

target_include_directories(app PRIVATE
  ${CMAKE_CURRENT_SOURCE_DIR}/../../main/sensors
  ${CMAKE_CURRENT_SOURCE_DIR}/../../main/transport
)
```

## prj.conf
```kconfig
# EMOPET TAG P0 compile-harness configuration.
# This is not the production MS88SF3 board authority.

CONFIG_BT=y
CONFIG_BT_PERIPHERAL=y
CONFIG_BT_DEVICE_NAME="EMOPET-TAG-P0"
CONFIG_BT_MAX_CONN=1

CONFIG_LOG=y
CONFIG_LOG_DEFAULT_LEVEL=3

CONFIG_MAIN_STACK_SIZE=2048
CONFIG_SYSTEM_WORKQUEUE_STACK_SIZE=2048
```

## src/main.c
```c
/*
 * EMOPET TAG P0 NCS/Zephyr entry point — #625.
 *
 * Current target is a compile harness only. Do not treat
 * nrf52840dk/nrf52840 as the production MS88SF3 board definition.
 */

#include <zephyr/bluetooth/bluetooth.h>
#include <zephyr/kernel.h>
#include <zephyr/logging/log.h>
#include <zephyr/sys/util.h>

#include "emopet_gatt.h"

LOG_MODULE_REGISTER(emopet_tag, LOG_LEVEL_INF);

static const struct bt_data advertising_data[] = {
    BT_DATA_BYTES(
        BT_DATA_FLAGS,
        BT_LE_AD_GENERAL | BT_LE_AD_NO_BREDR
    ),
    BT_DATA_BYTES(
        BT_DATA_UUID128_ALL,
        EMOPET_BT_UUID_SERVICE_VAL
    ),
};

int main(void)
{
    int err = bt_enable(NULL);
    if (err != 0) {
        LOG_ERR("Bluetooth enable failed: %d", err);
        return err;
    }

    err = bt_le_adv_start(
        BT_LE_ADV_CONN_FAST_1,
        advertising_data,
        ARRAY_SIZE(advertising_data),
        NULL,
        0
    );
    if (err != 0) {
        LOG_ERR("Advertising start failed: %d", err);
        return err;
    }

    LOG_INF("EMOPET TAG P0 BLE peripheral started");

    for (;;) {
        k_sleep(K_SECONDS(60));
    }

    return 0;
}
```

## src/emopet_gatt.c
```c
/*
 * EMOPET TAG GATT service — #625 G3 candidate.
 *
 * Scope:
 * - proprietary UUID service authority;
 * - SensorFrame characteristic registration;
 * - feature-summary characteristic registration + notify;
 * - canonical #623 serializer reuse.
 *
 * Out of scope:
 * - Device Trust (#66);
 * - command/claim authorization;
 * - secure boot / signed OTA;
 * - production MS88SF3 board definition;
 * - latent ELI semantics.
 */

#include "emopet_gatt.h"

#include <errno.h>
#include <stddef.h>
#include <stdint.h>

#include <zephyr/bluetooth/gatt.h>
#include <zephyr/logging/log.h>
#include <zephyr/sys/util.h>

LOG_MODULE_REGISTER(emopet_gatt, LOG_LEVEL_INF);

static bool sensor_notifications_enabled;
static bool feature_notifications_enabled;

static void sensor_ccc_changed(
    const struct bt_gatt_attr *attr,
    uint16_t value
)
{
    ARG_UNUSED(attr);
    sensor_notifications_enabled = (value == BT_GATT_CCC_NOTIFY);
    LOG_INF("SensorFrame notifications %s",
            sensor_notifications_enabled ? "enabled" : "disabled");
}

static void feature_ccc_changed(
    const struct bt_gatt_attr *attr,
    uint16_t value
)
{
    ARG_UNUSED(attr);
    feature_notifications_enabled = (value == BT_GATT_CCC_NOTIFY);
    LOG_INF("Feature-summary notifications %s",
            feature_notifications_enabled ? "enabled" : "disabled");
}

BT_GATT_SERVICE_DEFINE(
    emopet_svc,
    BT_GATT_PRIMARY_SERVICE(EMOPET_BT_UUID_SERVICE),

    BT_GATT_CHARACTERISTIC(
        EMOPET_BT_UUID_SENSOR_FRAME,
        BT_GATT_CHRC_NOTIFY,
        BT_GATT_PERM_NONE,
        NULL,
        NULL,
        NULL
    ),
    BT_GATT_CCC(
        sensor_ccc_changed,
        BT_GATT_PERM_READ | BT_GATT_PERM_WRITE
    ),

    BT_GATT_CHARACTERISTIC(
        EMOPET_BT_UUID_FEATURE_SUMMARY,
        BT_GATT_CHRC_NOTIFY,
        BT_GATT_PERM_NONE,
        NULL,
        NULL,
        NULL
    ),
    BT_GATT_CCC(
        feature_ccc_changed,
        BT_GATT_PERM_READ | BT_GATT_PERM_WRITE
    )
);

enum emopet_gatt_attr_index {
    EMOPET_ATTR_SERVICE = 0,
    EMOPET_ATTR_SENSOR_DECL = 1,
    EMOPET_ATTR_SENSOR_VALUE = 2,
    EMOPET_ATTR_SENSOR_CCC = 3,
    EMOPET_ATTR_FEATURE_DECL = 4,
    EMOPET_ATTR_FEATURE_VALUE = 5,
    EMOPET_ATTR_FEATURE_CCC = 6,
};

bool emopet_gatt_feature_notifications_enabled(void)
{
    return feature_notifications_enabled;
}

int emopet_gatt_notify_activity_variability(
    const tag_activity_feature_summary_input_t *input
)
{
    uint8_t frame[TAG_FEATURE_SUMMARY_FRAME_SIZE];

    if (input == NULL) {
        return -EINVAL;
    }
    if (!feature_notifications_enabled) {
        return -EACCES;
    }

    const tag_feature_summary_result_t encoded =
        tag_feature_summary_encode_activity_variability(
            input,
            frame,
            sizeof(frame)
        );

    if (encoded != TAG_FEATURE_SUMMARY_OK) {
        return -EINVAL;
    }

    return bt_gatt_notify(
        NULL,
        &emopet_svc.attrs[EMOPET_ATTR_FEATURE_VALUE],
        frame,
        sizeof(frame)
    );
}
```

## src/emopet_gatt.h
```c
/*
 * EMOPET TAG GATT peripheral boundary — #625.
 *
 * UUID values are controlled by config/ble/uuid-authority-v1.json.
 * A connected/CRC-valid BLE peer is NOT physical-device trust; #66 remains
 * authoritative for credentials, proof-of-possession and command trust.
 */

#pragma once

#include <stdbool.h>

#include <zephyr/bluetooth/uuid.h>

#include "activity_feature_summary.h"

#ifdef __cplusplus
extern "C" {
#endif

#define EMOPET_BT_UUID_SERVICE_VAL \
    BT_UUID_128_ENCODE(0xe4e2e9a3, 0x39c8, 0x4140, 0xaba9, 0xc4e37713f59a)
#define EMOPET_BT_UUID_SENSOR_FRAME_VAL \
    BT_UUID_128_ENCODE(0x66ae0c98, 0xa8ce, 0x4319, 0xb47d, 0xf09fa88d4d83)
#define EMOPET_BT_UUID_FEATURE_SUMMARY_VAL \
    BT_UUID_128_ENCODE(0x01141d55, 0xa776, 0x4091, 0xb068, 0x83f0804d8781)

#define EMOPET_BT_UUID_SERVICE \
    BT_UUID_DECLARE_128(EMOPET_BT_UUID_SERVICE_VAL)
#define EMOPET_BT_UUID_SENSOR_FRAME \
    BT_UUID_DECLARE_128(EMOPET_BT_UUID_SENSOR_FRAME_VAL)
#define EMOPET_BT_UUID_FEATURE_SUMMARY \
    BT_UUID_DECLARE_128(EMOPET_BT_UUID_FEATURE_SUMMARY_VAL)

/**
 * True when at least one central has enabled notifications for the bounded
 * feature-summary characteristic.
 *
 * P0 supports one connection only. Multi-peer CCC authority is deferred.
 */
bool emopet_gatt_feature_notifications_enabled(void);

/**
 * Encode through the canonical #623 C serializer and notify the controlled
 * feature-summary characteristic.
 *
 * The caller owns boot_session_id, sequence and monotonic window_end_ms.
 * This function does not invent those authorities.
 */
int emopet_gatt_notify_activity_variability(
    const tag_activity_feature_summary_input_t *input
);

#ifdef __cplusplus
}
#endif
```
